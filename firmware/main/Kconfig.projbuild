## firmware/main/Kconfig.projbuild
```kconfig
menu "SAR Notifier"

    config NOTIFIER_DEFAULT_SERVER_URL
        string "Default server URL"
        default "https://notifier.example.org"
        help
            Pre-filled in the setup portal. Members can change it there.

    config NOTIFIER_BOARD
        string "Board ID"
        default "xiao-c3"
        help
            Which board and pin map this build is for. The image embeds it, and the server
            only sends a pager updates built for its own board. Use a new ID whenever the
            pins or chip change.

    menu "Pins"
        comment "Defaults match the rev 1 board on a Seeed XIAO ESP32C3 (hardware/rev1)"

        config NOTIFIER_STATUS_LED_GPIO
            int "Status LED GPIO (green; -1 if none)"
            default 21
            help
                XIAO D6. Shows connection state.

        config NOTIFIER_ALERT_LED_GPIO
            int "Alert LED GPIO (red; -1 if none)"
            default 10
            help
                XIAO D10. The tall LED: pages and trouble.

        config NOTIFIER_LED_ACTIVE_LOW
            bool "LEDs are active low"
            default n

        config NOTIFIER_BUTTON_GPIO
            int "Button GPIO (active low, internal pull-up)"
            default 4
            help
                XIAO D2.

        config NOTIFIER_BUTTON_ALT_GPIO
            int "Second button GPIO, acts the same (-1 if none)"
            default 9
            help
                The dev board's BOOT button, so a bare board is usable too. GPIO9 is a
                strapping pin: holding it during reset enters the ROM bootloader.

        config NOTIFIER_SWITCH_GPIO
            int "Arm/quiet switch GPIO (-1 if none)"
            default 5
            help
                XIAO D3. Internal pull-up. High (open) = armed, low (closed to GND) = quiet.
                With nothing connected the device is always armed.

        config NOTIFIER_ALARM_GPIO
            int "Alarm output GPIO"
            default 3
            help
                XIAO D1. Drives the gate of the low-side MOSFET.

        config NOTIFIER_ALARM_GPIO_B
            int "Complementary alarm GPIO for bridge drive (-1 if none)"
            default -1
            help
                Only for driving a piezo through an H-bridge: set this to the second bridge
                input. It gets the inverted square wave, doubling the voltage across the
                piezo. Not needed for a transistor-switched buzzer or transducer.
    endmenu

    choice NOTIFIER_ALARM_DRIVE
        prompt "Alarm drive"
        default NOTIFIER_ALARM_DRIVE_PWM
        config NOTIFIER_ALARM_DRIVE_PWM
            bool "Square wave (passive piezo or magnetic transducer)"
        config NOTIFIER_ALARM_DRIVE_DC
            bool "On/off (active/self-drive buzzer)"
    endchoice

    config NOTIFIER_ALARM_FREQ_HZ
        int "Piezo drive frequency (Hz)"
        depends on NOTIFIER_ALARM_DRIVE_PWM
        default 2700
        help
            Set this to the transducer's resonant frequency; output drops off sharply away
            from it. 2700 suits the MLT-8530; the PUI AT-1224 is 2400.

    config NOTIFIER_ALARM_SECONDS
        int "How long a page sounds before switching to reminder chirps"
        default 60

    config NOTIFIER_REMINDER_MINUTES
        int "Reminder chirps for an unacknowledged page continue for (minutes)"
        default 10

    config NOTIFIER_TROUBLE_CHIRP_MINUTES
        int "Chirp when disconnected for this many minutes (0 = never)"
        default 30
        help
            Like a smoke detector's low-battery chirp: a silent, disconnected pager is the
            failure we most want members to notice. Only chirps while armed, then repeats
            every 10 minutes until reconnected.

endmenu
```
